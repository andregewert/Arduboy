/**
 * Copyright (c) 2021 André Gewert <agewert@ubergeek.de>
 *
 * Permission is hereby granted, free of charge, to any person obtaining a copy of
 * this software and associated documentation files (the "Software"), to deal in
 * the Software without restriction, including without limitation the rights to
 * use, copy, modify, merge, publish, distribute, sublicense, and/or sell copies of
 * the Software, and to permit persons to whom the Software is furnished to do so,
 * subject to the following conditions:
 *
 * The above copyright notice and this permission notice shall be included in all
 * copies or substantial portions of the Software.
 *
 * THE SOFTWARE IS PROVIDED "AS IS", WITHOUT WARRANTY OF ANY KIND, EXPRESS OR
 * IMPLIED, INCLUDING BUT NOT LIMITED TO THE WARRANTIES OF MERCHANTABILITY, FITNESS
 * FOR A PARTICULAR PURPOSE AND NONINFRINGEMENT. IN NO EVENT SHALL THE AUTHORS OR
 * COPYRIGHT HOLDERS BE LIABLE FOR ANY CLAIM, DAMAGES OR OTHER LIABILITY, WHETHER
 * IN AN ACTION OF CONTRACT, TORT OR OTHERWISE, ARISING FROM, OUT OF OR IN
 * CONNECTION WITH THE SOFTWARE OR THE USE OR OTHER DEALINGS IN THE SOFTWARE.
 */
#include <Arduboy2.h>

#define DIR_RIGHT 0
#define DIR_LEFT 1
#define DIR_UP 2
#define DIR_DOWN 3

#define DISPLAY_WIDTH 128
#define DISPLAY_HEIGHT 64
#define TILE_WIDTH 4
#define TILE_HEIGHT 4
#define MAX_SNAKE_LENGTH 256

Arduboy2 arduboy;
BeepPin1 beep;

bool gamePaused = false;
int gameScore = 0;
byte gameState = 0;
byte gameLevel = 1;
byte maxTileX = 0;
byte maxTileY = 0;
byte minTileX = 1;
byte minTileY = 1;

byte currentSpeed;
byte snakePartsX[MAX_SNAKE_LENGTH];
byte snakePartsY[MAX_SNAKE_LENGTH];
byte snakeDirection = 3;
byte snakeLength = 0;
bool snakeIsDead = false;
bool directionAlreadyChanged = false;

byte foodX = 0;
byte foodY = 0;
byte foodScore = 1;

const uint8_t PROGMEM titleImage[] = {
    0x00, 0x00, 0x00, 0x00, 0x00, 0x00, 0x00, 0x00, 0x00, 0x00, 0x00, 0x00,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 0x00,
    0x00, 0x00, 0x00, 0x00, 0x00, 0x00, 0x00, 0x00, 0x00, 0x00, 0x00, 0x00,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 0x00,
    0x00, 0x00, 0x00, 0x00, 0x00, 0x00, 0x00, 0x00, 0x00, 0x00, 0x00, 0x00,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 0x00,
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    0x00, 0x00, 0x00, 0x00, 0x00, 0x00, 0x00, 0x00, 0x00, 0x00, 0x00, 0x00,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 0x00,
};

void setup() {
    beep.begin();
    arduboy.begin();
    arduboy.setFrameRate(50);
    arduboy.initRandomSeed();
    arduboy.setTextSize(1);
    initTitleSnake();
}

void loop() {
    if (!arduboy.nextFrame()) return;
    arduboy.clear();
    arduboy.pollButtons();
    beep.timer();

    switch (gameState) {

        // Title screen
        case 0:
            arduboy.drawBitmap(0, 0, titleImage, 128, 64, WHITE);

            arduboy.setCursor(9, 52);
            arduboy.print("www.ubergeek.de");

            if (arduboy.frameCount %50 < 25) {
                arduboy.setCursor(16, 42);
                arduboy.print("- Press A -");
            }

            if (arduboy.everyXFrames(3)) {
                moveTitleSnake();
            }

            drawSnake();

            if (arduboy.justPressed(A_BUTTON)) {
                startNewGame();
            }
            break;

        // Game screen
        case 1:

            if (!snakeIsDead) {
                if (arduboy.justPressed(B_BUTTON)) {
                    gamePaused = !gamePaused;
                }

                if (!gamePaused && !directionAlreadyChanged) {
                    if (arduboy.justPressed(LEFT_BUTTON) && snakeDirection != DIR_RIGHT) {
                        snakeDirection = DIR_LEFT;
                        directionAlreadyChanged = true;
                    }
                    if (arduboy.justPressed(RIGHT_BUTTON) && snakeDirection != DIR_LEFT) {
                        snakeDirection = DIR_RIGHT;
                        directionAlreadyChanged = true;
                    }
                    if (arduboy.justPressed(UP_BUTTON) && snakeDirection != DIR_DOWN) {
                        snakeDirection = DIR_UP;
                        directionAlreadyChanged = true;
                    }
                    if (arduboy.justPressed(DOWN_BUTTON) && snakeDirection != DIR_UP) {
                        snakeDirection = DIR_DOWN;
                        directionAlreadyChanged = true;
                    }
                }

                // Update snake's state depending on current game speed
                if (!gamePaused && arduboy.everyXFrames(currentSpeed)) {

                    moveSnake();
                    directionAlreadyChanged = false;

                    if (isSnakeHittingBorder() || isSnakeBitingItself()) {
                        snakeDies();
                    }

                    // Head of snake is hitting food
                    if (isSnakeHittingFood()) {

                        for (byte i = 1; i <= foodScore; i++) {
                            gameScore = gameScore + 1;

                            if (snakeLength < MAX_SNAKE_LENGTH) {
                                snakeLength++;
                                snakePartsX[snakeLength - 1] = snakePartsX[snakeLength - 2];
                                snakePartsY[snakeLength - 1] = snakePartsY[snakeLength - 2];
                            }
                        }

                        int dummy = gameScore;
                        int levelScore = 9;
                        gameLevel = 0;
                        while (dummy > 0) {
                            gameLevel++;
                            levelScore = levelScore *1.3;
                            dummy -= levelScore;
                        }
                        
                        if (gameLevel < 8) {
                            currentSpeed = 9 -gameLevel;
                        } else {
                            currentSpeed = 1;
                        }

                        arduboy.setRGBled(158, 19, 126);
                        beep.tone(beep.freq(1500), 1);
                        delay(75);
                        arduboy.setRGBled(0, 0, 0);

                        addFood();
                    }
                }
            }
            
            // Draw current game state
            drawScreenFrame();
            drawFood();
            drawSnake();

            // Pause overlay
            if (gamePaused) {
                drawPauseOverlay();
            }
            
            // Press A for new game
            if (snakeIsDead && arduboy.justPressed(A_BUTTON)) {
                gameState = 0;
                initTitleSnake();
                arduboy.setRGBled(0, 0, 0);
            }

            break;
    }
    arduboy.display();
}


#pragma region Functions

void initTitleSnake() {
    maxTileX = (DISPLAY_WIDTH / TILE_WIDTH) -1;
    maxTileY = (DISPLAY_HEIGHT / TILE_HEIGHT) -1;

    snakeDirection = DIR_RIGHT;
    snakeLength = random(5, 16);

    for (byte i = 0; i < snakeLength; i++) {
        snakePartsX[i] = (snakeLength -i +4) * TILE_WIDTH;
        snakePartsY[i] = TILE_HEIGHT;
    }
}

void moveTitleSnake() {
    switch (snakeDirection) {
        case DIR_LEFT:
            if (snakePartsX[0] == minTileX *TILE_WIDTH) {
                snakeDirection = DIR_UP;
            }
            break;
        case DIR_RIGHT:
            if (snakePartsX[0] == maxTileX * TILE_WIDTH) {
                snakeDirection = DIR_DOWN;
            }
            break;
        case DIR_DOWN:
            if (snakePartsY[0] == maxTileY * TILE_HEIGHT) {
                snakeDirection = DIR_LEFT;
            }
            break;
        case DIR_UP:
            if (snakePartsY[0] == minTileY * TILE_HEIGHT) {
                snakeDirection = DIR_RIGHT;
            }
            break;
    }
    moveSnake();
}

void startNewGame() {
    gameState = 1;
    gameScore = 0;
    gameLevel = 1;

    snakeDirection = 0;
    snakeLength = 3;
    snakeIsDead = false;

    maxTileX = (DISPLAY_WIDTH / TILE_WIDTH) - 1;
    maxTileY = (DISPLAY_HEIGHT / TILE_HEIGHT) - 3;

    snakePartsX[0] = 2 * TILE_WIDTH;
    snakePartsX[1] = 1 * TILE_WIDTH;
    snakePartsX[2] = 0 * TILE_WIDTH;
    snakePartsY[0] = TILE_HEIGHT;
    snakePartsY[1] = TILE_HEIGHT;
    snakePartsY[2] = TILE_HEIGHT;
    currentSpeed = 8;
    gamePaused = false;

    addFood();
}

void snakeDies() {
    arduboy.setRGBled(255, 0, 0);
    snakeIsDead = true;
    beep.tone(beep.freq(1100), 80);
    delay(80);
    beep.noTone();
    delay(20);
    beep.tone(beep.freq(1000), 80);
    delay(80);
    beep.noTone();
    delay(20);
    beep.tone(beep.freq(500), 500);
    delay(500);
    beep.noTone();
    delay(20);
}

bool isSnakeHittingFood() {
    return snakePartsX[0] == foodX && snakePartsY[0] == foodY;
}

bool isSnakeHittingBorder() {
    switch (snakeDirection) {
        case DIR_LEFT:
            return snakePartsX[0] < (minTileX * TILE_WIDTH);
            break;
        case DIR_RIGHT:
            return snakePartsX[0] >= (maxTileX * TILE_WIDTH);
            break;
        case DIR_DOWN:
            return snakePartsY[0] >= (maxTileY * TILE_HEIGHT);
            break;
        case DIR_UP:
            return snakePartsY[0] < (minTileY * TILE_HEIGHT);
            break;
    }
    return false;
}

void drawScreenFrame() {
    arduboy.drawRect(TILE_WIDTH / 2, TILE_HEIGHT / 2, DISPLAY_WIDTH - TILE_WIDTH, DISPLAY_HEIGHT - 3 * TILE_HEIGHT, WHITE);
    arduboy.setTextSize(1);
    arduboy.setCursor(TILE_WIDTH / 2, DISPLAY_HEIGHT - arduboy.getCharacterHeight(1));
    arduboy.print("Score: ");
    arduboy.print(gameScore);
    arduboy.setCursor(TILE_WIDTH / 2 + arduboy.getCharacterWidth(1) * 13, DISPLAY_HEIGHT - arduboy.getCharacterHeight(1));
    arduboy.print("Level: ");
    arduboy.print(gameLevel);
}

void drawFood() {
    arduboy.fillCircle(foodX +(TILE_WIDTH /2), foodY +(TILE_HEIGHT /2), TILE_WIDTH /2, WHITE);
}

void drawSnake() {
    for (int i = 0; i < snakeLength; i++) {
        arduboy.drawRect(snakePartsX[i], snakePartsY[i], TILE_WIDTH, TILE_HEIGHT, WHITE);
    }
}

void drawPauseOverlay() {
    if (arduboy.frameCount % 50 < 25) {
        arduboy.setTextSize(2);
        arduboy.setCursor(10, 20);
        arduboy.print("- PAUSE -");
    }
}

void moveSnake() {
    for (int i = snakeLength - 2; i >= 0; i--) {
        snakePartsX[i + 1] = snakePartsX[i];
        snakePartsY[i + 1] = snakePartsY[i];
    }
    switch (snakeDirection)
    {
        case DIR_RIGHT:
            snakePartsX[0] += TILE_WIDTH;
            break;
        case DIR_LEFT:
            snakePartsX[0] -= TILE_WIDTH;
            break;
        case DIR_DOWN:
            snakePartsY[0] += TILE_HEIGHT;
            break;
        case DIR_UP:
            snakePartsY[0] -= TILE_HEIGHT;
            break;
    }
}

void addFood() {
    bool snakeBitesItself = false;

    do {
        snakeBitesItself = false;
        foodX = random(minTileX, maxTileX) * TILE_WIDTH;
        foodY = random(minTileY, maxTileY) * TILE_HEIGHT;

        for (int i = 0; i < snakeLength; i++) {
            if (snakePartsX[i] == foodX && snakePartsY[i] == foodY) {
                snakeBitesItself = true;
                break;
            }
        }
    } while (snakeBitesItself);

    foodScore = random(1, 5);
}

bool isSnakeBitingItself() {
    for (byte i = 1; i < snakeLength; i++) {
        if (snakePartsX[i] == snakePartsX[0] && snakePartsY[i] == snakePartsY[0]) {
            return true;
        }
    }
    return false;
}

#pragma endregion
